## main/Kconfig.projbuild
```kconfig
menu "CKB Light Client"

    if IDF_TARGET_ESP32S3
    menu "WiFi Configuration"

        config CKB_WIFI_SSID
            string "WiFi SSID"
            default "myssid"
            help
                SSID for the WiFi network the S3 will connect to.

        config CKB_WIFI_PASSWORD
            string "WiFi Password"
            default "mypassword"
            help
                WiFi password. Leave empty for open networks.

    endmenu
    endif

    config CKB_NODE_HOST
        string "CKB Node IP/Hostname"
        default "192.168.68.87"
        help
            IP address or hostname of the CKB node to connect to.

    config CKB_NODE_PORT
        int "CKB Node P2P Port"
        default 8115
        help
            P2P port of the CKB node (default 8115).

endmenu
```

## sdkconfig.defaults.esp32c6
```kconfig
# sdkconfig.defaults.esp32c6
# CKB Light Client — ESP32-C6 (native WiFi 6, RISC-V)
CONFIG_IDF_TARGET="esp32c6"

# Native WiFi backend
CONFIG_CKB_WIFI_NATIVE=y

# WiFi
CONFIG_ESP_WIFI_ENABLED=y
CONFIG_ESP32C6_DEFAULT_CPU_FREQ_160=y

# Stack sizes — C6 is single-core RISC-V, keep tasks lean
CONFIG_ESP_MAIN_TASK_STACK_SIZE=8192

# Disable P4-specific features
CONFIG_SPIRAM=n

# Log level
CONFIG_LOG_DEFAULT_LEVEL_INFO=y
```

## sdkconfig.defaults.esp32p4
```kconfig
# sdkconfig defaults for ESP32-P4 + W5500
CONFIG_IDF_TARGET="esp32p4"
CONFIG_CKB_NODE_HOST="192.168.68.87"
CONFIG_CKB_NODE_PORT=8115
CONFIG_ETH_USE_SPI_ETHERNET=y
CONFIG_ETH_SPI_ETHERNET_W5500=y
```

## sdkconfig.defaults.esp32s3
```kconfig
# sdkconfig defaults for ESP32-S3 + native WiFi
CONFIG_IDF_TARGET="esp32s3"
CONFIG_ESPTOOLPY_FLASHSIZE_8MB=y
CONFIG_SPIRAM=y
CONFIG_SPIRAM_MODE_OCT=y
CONFIG_SPIRAM_SPEED_80M=y
CONFIG_CKB_WIFI_SSID="your_ssid"
CONFIG_CKB_WIFI_PASSWORD="your_password"
CONFIG_CKB_NODE_HOST="192.168.68.87"
CONFIG_CKB_NODE_PORT=8115
```
